#include <behaviors.dtsi>
#include <dt-bindings/zmk/keys.h>
#include <dt-bindings/zmk/bt.h>
#include <dt-bindings/zmk/pointing.h>

#define DEFAULT_LAYER   0
#define SCROLL_LAYER    1

/ {
    keymap {
        compatible = "zmk,keymap";

        default_layer {
            bindings = <
                &kp T
           >;
        };

        scroll_layer {  //called by trackpad code to switch to scroll mode
            bindings = <
                &kp Y
           >;
        };
    };
};